## config/west.yml
```yaml
#defaultの設定
manifest:
  remotes:
    - name: zmkfirmware
      url-base: https://github.com/zmkfirmware
    - name: badjeff
      url-base: https://github.com/badjeff
    - name: caksoylar
      url-base: https://github.com/caksoylar
    - name: ImSota
      url-base: https://github.com/ImSota
  projects:
    - name: zmk
      remote: zmkfirmware
      revision: v0.3
      import: app/west.yml
    - name: zmk-pmw3610-driver
      remote: badjeff
      revision: zmk-0.3
    - name: zmk-rgbled-widget
      remote: caksoylar
      revision: main
    - name: zmk-naginata
      remote: ImSota
      revision: 2544a5a
  self:
    path: config

  # manifest:
  # remotes:
  #   - name: ImSota
  #     url-base: https://github.com/ImSota
  #   - name: inorichi
  #     url-base: https://github.com/inorichi
  #   - name: caksoylar
  #     url-base: https://github.com/caksoylar
  # projects:
  #   - name: zmk
  #     remote: ImSota
  #     revision: main
  #     import: app/west.yml
  #   - name: zmk-pmw3610-driver
  #     remote: inorichi
  #     revision: main
  #   - name: zmk-rgbled-widget
  #     remote: caksoylar
  #     revision: main
  # self:
  #   path: config
```
